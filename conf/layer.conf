## conf/layer.conf
```bitbake
# We have a conf and classes directory, append to BBPATH
BBPATH .= ":${LAYERDIR}"

# We have a recipes directory, add to BBFILES
BBFILES += "${LAYERDIR}/recipes*/*/*.bb ${LAYERDIR}/recipes*/*/*.bbappend ${LAYERDIR}/images/*.bb"

BBFILE_COLLECTIONS += "meta-cxxscore"
BBFILE_PATTERN_meta-cxxscore := "^${LAYERDIR}/"
BBFILE_PRIORITY_meta-cxxscore = "100"

LAYERSERIES_COMPAT_meta-cxxscore = "sumo thud warrior zeus"
```
